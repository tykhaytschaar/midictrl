## components/config/Kconfig
```kconfig
menu "midictrl"

config MIDICTRL_PROGRAMS_PER_BANK
    int "Programs per bank"
    default 5
    range 2 5
    help
        Number of program slots per bank, matching the physical
        footswitch count. Changing this changes both the in-memory
        config_t layout and the slot buttons rendered in the web UI.

endmenu
```

## sdkconfig.defaults
```kconfig
# Settings common to every supported target.
# Target-specific overrides (chip, flash size, partition file) live in
# sdkconfig.defaults.<target>. Pick a target with `idf.py set-target esp32`
# or `idf.py set-target esp32s3` (or use tools/build.sh).

# Custom partition table — filename is set per target.
CONFIG_PARTITION_TABLE_CUSTOM=y

# Slightly larger main task stack for the bring-up phase.
CONFIG_ESP_MAIN_TASK_STACK_SIZE=8192

# WebSocket support in esp_http_server — needed by the web_server component.
CONFIG_HTTPD_WS_SUPPORT=y
```

## sdkconfig.defaults.esp32s3
```kconfig
# ESP32-S3 (-WROOM-1 N16R8) target — full-feature spec build.
CONFIG_ESPTOOLPY_FLASHSIZE_16MB=y
CONFIG_PARTITION_TABLE_CUSTOM_FILENAME="partitions.esp32s3.csv"
```
